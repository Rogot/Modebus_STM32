# file: PLC - STM32.ioc
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Mcu.Family=STM32F4
Mcu.Name=STM32F405RGTx
Mcu.Package=LQFP64
NVIC.PriorityGroup=NVIC_PRIORITYGROUP_4
PA13.Mode=Serial_Wire
PA13.Signal=SYS_JTMS-SWDIO
PA14.Mode=Serial_Wire
PA14.Signal=SYS_JTCK-SWCLK
PC14-OSC32_IN.Mode=LSE-External-Oscillator
PC14-OSC32_IN.Signal=RCC_OSC32_IN
PC15-OSC32_OUT.Mode=LSE-External-Oscillator
PC15-OSC32_OUT.Signal=RCC_OSC32_OUT
PH0-OSC_IN.Mode=HSE-External-Oscillator
PH0-OSC_IN.Signal=RCC_OSC_IN
PH1-OSC_OUT.Mode=HSE-External-Oscillator
PH1-OSC_OUT.Signal=RCC_OSC_OUT
ProjectManager.HeapSize=0x200
ProjectManager.StackSize=0x400
ProjectManager.TargetToolchain=STM32CubeIDE
RCC.48MHZClocksFreq_Value=36000000
RCC.AHBFreq_Value=72000000
RCC.APB1CLKDivider=RCC_HCLK_DIV2
RCC.APB1Freq_Value=36000000
RCC.APB1TimFreq_Value=72000000
RCC.APB2Freq_Value=72000000
RCC.APB2TimFreq_Value=72000000
RCC.CortexFreq_Value=72000000
RCC.HCLKFreq_Value=72000000
RCC.HSE_VALUE=25000000
RCC.HSI_VALUE=16000000
RCC.PLLM=8
RCC.PLLN=72
RCC.SYSCLKFreq_VALUE=72000000
RCC.SYSCLKSource=RCC_SYSCLKSOURCE_PLLCLK
RCC.VCOOutputFreq_Value=144000000
board=custom

// file: Core/Src/main.c
/* USER CODE BEGIN Header */
/**
  ******************************************************************************
  * @file           : main.c
  * @brief          : Main program body
  ******************************************************************************
  * @attention
  *
  * <h2><center>&copy; Copyright (c) 2023 STMicroelectronics.
  * All rights reserved.</center></h2>
  *
  * This software component is licensed by ST under BSD 3-Clause license,
  * the "License"; You may not use this file except in compliance with the
  * License. You may obtain a copy of the License at:
  *                        opensource.org/licenses/BSD-3-Clause
  *
  ******************************************************************************
  */
/* USER CODE END Header */
#include "main.h"

/* USER CODE BEGIN Includes */
#include "modebus.h"
/* USER CODE END Includes */

/* USER CODE BEGIN PV */

t_modbus modbus;
uint16_t data_buffer[MODBUS_DATA_BUF_SIZE];
/* USER CODE END PV */

void SystemClock_Config(void);
static void MX_GPIO_Init(void);

int main(void)
{

  /* MCU Configuration--------------------------------------------------------*/

  /* Reset of all peripherals, Initializes the Flash interface and the Systick. */
  HAL_Init();

  /* Configure the system clock */
  SystemClock_Config();

  /* USER CODE BEGIN SysInit */
  	modbus.usart = malloc(sizeof(t_usart));
  	modbus.dma = malloc(sizeof(t_dma));
  	modbus.usart->usart_type = USART1;
  	modbus.timer = TIM1;

  	for (uint8_t i = 0; i < 255; i++) {
  		modbus.pack.data[i] = i;
  	}
  	modbus.pack.len = 255;

  	/* USART CONFIG */

  	modbus.usart->friq = 115200;
  	modbus.usart->data_dir = RX_TX_MODE;
  	modbus.usart->word_length = BIT_8;
  	modbus.usart->usart_en = USART_ENABLE;
  	modbus.usart->intrpt_en = RXNE_INTERRUPT_ENABLE;
  	modbus.usart->intrpt_perm = INTERRUPT_PERMISSION_ENABLE;
//  	modbus.usart->dma_en = RXE_DMA_ENABLE;

  	/* ~USART CONFIG~ */

  	/* TIM CONFIG */

  	/* ~TIM CONFIG~ */

  	/* DMA CONFIG */
#if 0
  	modbus.dma->dma_stream = DMA2_Stream2;
  	modbus.dma->dma_channel = DMA_CHANNEL_4;
  	modbus.dma->dma_dir = DMA_PER_TO_MEM;
  	modbus.dma->dma_circ = DMA_CIRC_ENABLE;
  	modbus.dma->dma_pl = DMA_PRIORITY_LEVEL_HIGH;
  	modbus.dma->dma_psize = DMA_HALF_WORD_SIZE; /* 16 bit */
  	modbus.dma->dma_msize = DMA_HALF_WORD_SIZE; /* 16 bit */
  	modbus.dma->dma_minc = DMA_INCREMENT_ENABLE;
  	modbus.dma->dma_pinc = DMA_INCREMENT_DISABLE;
  	modbus.dma->dma_intrpt_en = DMA_INTERRUPT_TRAN_COMP_DISABLE;
  	modbus.dma->dma_intrpt_half_en = DMA_INTERRUPT_HALF_TRAN_COMP_DISABLE;
  	modbus.dma->dma_par = &(USART1->DR);
  	modbus.dma->dma_m0ar = data_buffer;
  	modbus.dma->dma_ndtr = MODBUS_DATA_BUF_SIZE;
  	modbus.dma->dma_permis_intrpt_en = DMA_INTERRUPT_PERMISSION_DISABLE;
  	modbus.dma->dma_en = DMA_ENABLE;
#endif
  	/* ~DMA CONFIG~ */

  	modbus_init(&modbus);

  /* USER CODE END SysInit */

  /* Initialize all configured peripherals */
  MX_GPIO_Init();
  /* USER CODE BEGIN 2 */
	/* PA4 - шип 1 */
	GPIOA->MODER &= ~GPIO_MODER_MODE4;
	GPIOA->MODER |= GPIO_MODER_MODE4_0; //Output mode
	GPIOA->OSPEEDR |= GPIO_OSPEEDER_OSPEEDR4_1;
  /* USER CODE END 2 */

  /* Infinite loop */
  while (1)
  {

  }
}

void SystemClock_Config(void)
{
  RCC_OscInitTypeDef RCC_OscInitStruct = {0};
  RCC_ClkInitTypeDef RCC_ClkInitStruct = {0};

  /** Configure the main internal regulator output voltage
  */
  __HAL_RCC_PWR_CLK_ENABLE();
  __HAL_PWR_VOLTAGESCALING_CONFIG(PWR_REGULATOR_VOLTAGE_SCALE1);
  /** Initializes the RCC Oscillators according to the specified parameters
  * in the RCC_OscInitTypeDef structure.
  */
  RCC_OscInitStruct.OscillatorType = RCC_OSCILLATORTYPE_HSI;
  RCC_OscInitStruct.HSIState = RCC_HSI_ON;
  RCC_OscInitStruct.HSICalibrationValue = RCC_HSICALIBRATION_DEFAULT;
  RCC_OscInitStruct.PLL.PLLState = RCC_PLL_ON;
  RCC_OscInitStruct.PLL.PLLSource = RCC_PLLSOURCE_HSI;
  RCC_OscInitStruct.PLL.PLLM = 8;
  RCC_OscInitStruct.PLL.PLLN = 72;
  RCC_OscInitStruct.PLL.PLLP = RCC_PLLP_DIV2;
  RCC_OscInitStruct.PLL.PLLQ = 4;
  if (HAL_RCC_OscConfig(&RCC_OscInitStruct) != HAL_OK)
  {
    Error_Handler();
  }
  /** Initializes the CPU, AHB and APB buses clocks
  */
  RCC_ClkInitStruct.ClockType = RCC_CLOCKTYPE_HCLK|RCC_CLOCKTYPE_SYSCLK
                              |RCC_CLOCKTYPE_PCLK1|RCC_CLOCKTYPE_PCLK2;
  RCC_ClkInitStruct.SYSCLKSource = RCC_SYSCLKSOURCE_PLLCLK;
  RCC_ClkInitStruct.AHBCLKDivider = RCC_SYSCLK_DIV1;
  RCC_ClkInitStruct.APB1CLKDivider = RCC_HCLK_DIV2;
  RCC_ClkInitStruct.APB2CLKDivider = RCC_HCLK_DIV1;

  if (HAL_RCC_ClockConfig(&RCC_ClkInitStruct, FLASH_LATENCY_2) != HAL_OK)
  {
    Error_Handler();
  }
}

static void MX_GPIO_Init(void)
{

  /* GPIO Ports Clock Enable */
  __HAL_RCC_GPIOC_CLK_ENABLE();
  __HAL_RCC_GPIOH_CLK_ENABLE();
  __HAL_RCC_GPIOA_CLK_ENABLE();

}

void Error_Handler(void)
{
  __disable_irq();
  while (1)
  {
  }
}

/************************ (C) COPYRIGHT STMicroelectronics *****END OF FILE****/
